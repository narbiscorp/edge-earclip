## EDGE/EDGE FIRMWARE/sdkconfig.defaults
```kconfig
# Narbis glasses — ESP-IDF defaults.
# Pin: ESP-IDF v5.5.1 (matches earclip; see CLAUDE.md). Do not silently upgrade.
#
# Glasses run an ESP32 (NOT ESP32-C6 like the earclip). The Bluedroid host
# stack is used here intentionally — porting glasses to NimBLE is tracked
# as a v2 cleanup in TODO.md. Earclip uses NimBLE.

# ---------------- target ----------------
CONFIG_IDF_TARGET="esp32"

# ---------------- flash + partition table ----------------
CONFIG_ESPTOOLPY_FLASHSIZE_4MB=y
CONFIG_ESPTOOLPY_FLASHSIZE="4MB"

CONFIG_PARTITION_TABLE_CUSTOM=y
CONFIG_PARTITION_TABLE_CUSTOM_FILENAME="partitions.csv"
CONFIG_PARTITION_TABLE_OFFSET=0x8000

# ---------------- Bluetooth (Bluedroid host, dual-role) ----------------
# Path B: glasses are now both BLE peripheral (existing OTA + control
# service on 0xFF01..0xFF04 still serves the phone/dashboard) AND BLE
# central (connects to a Narbis earclip and subscribes to IBI notifies).
# Both roles live in one Bluedroid stack.
CONFIG_BT_ENABLED=y
CONFIG_BT_BLUEDROID_ENABLED=y
CONFIG_BT_GATTS_ENABLE=y
CONFIG_BT_GATTC_ENABLE=y
CONFIG_BT_BLE_DUAL_ROLE=y

# ---------------- Power management ----------------
# Light sleep is disabled in this firmware (breaks BLE streaming); CPU is
# capped at 80 MHz via esp_pm_configure in app_main. Keep PM framework on
# so the existing esp_pm_configure call path stays valid.
CONFIG_PM_ENABLE=y

# ---------------- Logging ----------------
CONFIG_LOG_DEFAULT_LEVEL_INFO=y
```

## edge-additions/Kconfig.additions
```kconfig
# Kconfig.additions — paste these into Edge's main/Kconfig.projbuild
# (or any Kconfig file under "menu \"Narbis Earclip\"" if you prefer).
#
# Symbol names match the earclip's own Kconfig so you can reuse the same
# operational tooling. Do not rename them.

config NARBIS_HARDCODED_PARTNER_MAC
    bool "Use hardcoded ESP-NOW partner (earclip) MAC as fallback"
    default y
    help
        When the Edge runtime config has not yet been populated (no MAC in
        NVS namespace "narbis_pair", key "partner_mac"), fall back to the
        MAC compiled in via NARBIS_HARDCODED_PARTNER_MAC_VAL.

config NARBIS_HARDCODED_PARTNER_MAC_VAL
    string "Hardcoded earclip MAC (colon-separated, six octets)"
    depends on NARBIS_HARDCODED_PARTNER_MAC
    default "FF:FF:FF:FF:FF:FF"
    help
        Six-byte MAC, colon-separated, used when no partner MAC is stored
        in NVS. The default broadcast address makes unconfigured Edge
        units inert until paired (no peer added, all frames dropped as
        wrong-peer).
```

## firmware/main/Kconfig.projbuild
```kconfig
menu "Narbis earclip"

    config NARBIS_TEST_INJECT
        bool "Use synthetic 1 Hz PPG injector instead of real driver"
        default n
        help
            Replaces the MAX3010x driver with a built-in 1 Hz sine generator
            for end-to-end DSP smoke testing without hardware. Expected
            output is a beat event every ~1000 ms with confidence near 100
            and no ARTIFACT flag once the running median has filled.

    comment "Battery sense (XIAO ESP32-C6 hardware mod)"

    config NARBIS_BATT_DIVIDER_PRESENT
        bool "Battery voltage divider populated on the XIAO C6"
        default n
        help
            Set to y after soldering a 1 MΩ : 1 MΩ resistor divider from
            BAT+ → A1 (GPIO1) → GND on the XIAO ESP32-C6. While n
            (default), power_mgmt_get_battery() returns placeholder
            values (4000 mV / 80%) with a rate-limited STUB warning so
            BLE battery frames stay meaningful for transport testing.
            See TODO.md and CLAUDE.md hardware section.

    config NARBIS_BATT_ADC_GPIO
        int "Battery sense ADC GPIO"
        depends on NARBIS_BATT_DIVIDER_PRESENT
        range 0 6
        default 1
        help
            GPIO wired to the divider midpoint. Must be ADC1-capable
            on the ESP32-C6 (GPIO0..GPIO6 = ADC1_CH0..CH6).

            Practical options on the Seeed XIAO ESP32-C6 board:
              GPIO0 (D0 / A0) — ADC1_CH0; CONFLICTS with PPG INT,
                                do not use unless you've moved the
                                MAX3010x interrupt off this pin.
              GPIO1 (D1 / A1) — ADC1_CH1; default, recommended.
              GPIO2 (D2 / A2) — ADC1_CH2; CONFLICTS with sleep button
                                (LP_IO wake source — see sleep_button).
              GPIO3..GPIO6    — ADC-capable on the chip but NOT
                                broken out on the XIAO board.

            Other XIAO labeled pins (D3..D10 → GPIO16..23) are not
            ADC-capable on the C6 and will fail at boot.

    config NARBIS_BATT_ADC_DIV_NUM
        int "Battery divider numerator"
        depends on NARBIS_BATT_DIVIDER_PRESENT
        range 1 255
        default 2
        help
            Divider ratio numerator. With a 1:1 divider (BAT+ → 1 MΩ →
            ADC pin → 1 MΩ → GND), the pin sees half of BAT+, so the
            firmware multiplies the ADC voltage by 2/1 = NUM/DEN.

            Range is wide enough to absorb resistor-tolerance and
            ADC-bias correction. For example, if the bench reads 4000 mV
            but firmware reports 3880 mV (3.1% low), set NUM=33 / DEN=16
            (= 2.0625) to scale all readings up by exactly that amount
            while keeping the math integer.

    config NARBIS_BATT_ADC_DIV_DEN
        int "Battery divider denominator"
        depends on NARBIS_BATT_DIVIDER_PRESENT
        range 1 255
        default 1
        help
            Divider ratio denominator. See NARBIS_BATT_ADC_DIV_NUM.

    config NARBIS_PPG_POLL_FALLBACK_MS
        int "PPG FIFO poll-fallback interval (ms, 0 = IRQ only)"
        range 0 200
        default 25
        help
            If nonzero, ppg_task wakes every N ms and drains the MAX3010x
            FIFO directly via I2C, in addition to whatever the chip's INT
            line does. Useful — and apparently necessary on the current
            hardware revision — as a workaround for an unreliable INT
            line. Setting this to 0 (pure-IRQ) saves ~1–2 mA but the
            FIFO will overrun and the device will produce no beats if
            the INT pin doesn't fire reliably. Default 25 ms is safe
            and keeps up comfortably with 200 Hz sampling (FIFO crosses
            A_FULL threshold every ~85 ms). Drop to 0 only after
            verifying that "no IRQ in 1s — sensor stalled?" warnings
            never appear in the boot log.

    config NARBIS_AGC_LED_MAX_X10
        int "AGC LED current cap (0.1 mA units)"
        range 50 510
        default 200
        help
            Maximum LED current the AGC will drive each LED to, in 0.1 mA
            units. The MAX3010x hardware max is 510 (51.0 mA), but
            pumping the LED that hard rarely fixes a real signal problem
            — it usually means the optical interface is broken (loose
            earclip, no finger, dirt) and the extra current is wasted.
            Default 200 (= 20.0 mA) is roughly the upper bound of "useful
            on a reasonable optical interface". Logs a one-shot warning
            ("agc railed at LED cap") when this cap is hit, so a poor
            optical coupling stays visible.

    config NARBIS_IDLE_SLEEP_TIMEOUT_S
        int "Idle deep-sleep timeout (seconds, 0 = disabled)"
        range 0 3600
        default 300
        help
            If nonzero, the earclip enters deep sleep after this many
            seconds with zero BLE peers connected. Press the sleep
            button (D2 / GPIO2) to wake — same wake source as the
            manual hold-to-sleep gesture.

            Defaults to 300 (5 minutes). The timer is evaluated by the
            existing sleep_button polling task (50 ms cadence) and is
            reset on every poll where transport_ble_any_connected()
            returns true. Set to 0 to disable the idle-sleep timer
            entirely (manual button hold still works).

            Use a smaller value (e.g. 60) for bench testing.

    menu "Power-draw bisection (debug only)"

        config NARBIS_DISABLE_BLE
            bool "Skip BLE init at boot"
            default n
            help
                Skips transport_ble_init() and every ble_service_*_init().
                NimBLE stack stays down, dropping the BT controller
                pm_lock that pins CPU at 160 MHz. Use only for
                current-draw bisection.

    endmenu

    menu "OTA"

        config NARBIS_OTA_VALIDITY_TIMEOUT_S
            int "First-connect timeout for OTA validity self-test (s)"
            range 5 600
            default 60
            help
                On boot from a freshly-OTA'd partition (state =
                ESP_OTA_IMG_PENDING_VERIFY), the firmware waits up to
                this many seconds for a BLE central to connect before
                marking the image valid. If no connection happens, the
                bootloader rolls back to the previous slot on the next
                reset. 60 s mirrors the staged-prompt requirement.

    endmenu

endmenu
```

## firmware/sdkconfig.defaults
```kconfig
# Narbis earclip — ESP-IDF defaults.
# Pin: ESP-IDF v5.5.1 (see CLAUDE.md). Do not silently upgrade.

# ---------------- target ----------------
CONFIG_IDF_TARGET="esp32c6"

# ---------------- flash + partition table ----------------
# XIAO ESP32-C6 has 4 MB flash. The partition table assumes that size.
CONFIG_ESPTOOLPY_FLASHSIZE_4MB=y
CONFIG_ESPTOOLPY_FLASHSIZE="4MB"

CONFIG_PARTITION_TABLE_CUSTOM=y
CONFIG_PARTITION_TABLE_CUSTOM_FILENAME="partitions.csv"
CONFIG_PARTITION_TABLE_OFFSET=0x8000

# ---------------- Bluetooth (NimBLE host) ----------------
CONFIG_BT_ENABLED=y
CONFIG_BT_NIMBLE_ENABLED=y
CONFIG_BT_CONTROLLER_ENABLED=y
# BLE controller modem-sleep. With this off (default in IDF 5.5), the BT
# controller holds an ESP_PM_CPU_FREQ_MAX lock 100% of the time, pinning
# the CPU at 160 MHz and blocking light sleep entirely (visible in
# esp_pm_dump_locks as "bt CPU_FREQ_MAX 100%"). Turning it on lets the
# controller dropthe lock between conn events. Sleep clock is the main
# XTAL by default (BT_LE_LP_CLK_SRC_MAIN_XTAL) — XIAO C6 has no
# external 32 kHz crystal.
CONFIG_BT_LE_SLEEP_ENABLE=y
# BLE light sleep requires the MAC and Baseband to power down with the
# rest of the system — without this the controller's sleep callback
# can't actually park the radio. Build error if BT_LE_SLEEP_ENABLE is
# set without this.
CONFIG_MAC_BB_PD=y
# Multi-central. Path B accepts 2 simultaneous centrals (dashboard + glasses);
# 3 leaves a slot for a debug client. Both host (NimBLE) and controller
# (LE) caps must be raised — host alone is a footgun (the controller will
# reject the third connect even though the host expected it to fit).
CONFIG_BT_NIMBLE_MAX_CONNECTIONS=3
CONFIG_BT_LE_MAX_CONNECTIONS=3

# ---------------- Power management ----------------
# Light sleep is the only sleep mode allowed (CLAUDE.md: no deep sleep on the
# earclip — incompatible with continuous sampling). Stage 07 wires up actual
# sleep entry; here we just enable the framework.
CONFIG_PM_ENABLE=y
CONFIG_FREERTOS_USE_TICKLESS_IDLE=y
# Light-sleep / lock-holder profiling. esp_pm_dump_locks() prints which
# component is holding the CPU/APB at MAX. Enabled while we hunt down
# why average current is far above target.
CONFIG_PM_PROFILING=y
CONFIG_PM_DFS_INIT_AUTO=y
# Track total time spent in light sleep so we can verify it's actually
# entering. esp_pm_get_sleep_stats() (or the dump_locks output) reports it.
CONFIG_FREERTOS_GENERATE_RUN_TIME_STATS=y
CONFIG_FREERTOS_USE_TRACE_FACILITY=y
CONFIG_FREERTOS_USE_STATS_FORMATTING_FUNCTIONS=y

# ---------------- Logging ----------------
CONFIG_LOG_DEFAULT_LEVEL_INFO=y

# ---------------- Battery sense ----------------
# CI release binaries assume the 1 MΩ : 1 MΩ resistor divider is
# soldered (or breadboarded) on every Narbis earclip board, BAT+ →
# GPIO1 → GND, so power_mgmt_get_battery() reads real voltage instead
# of returning the 4000 mV / 80% stub. Boards without the divider will
# read random floating-pin values; for a fresh out-of-the-box XIAO,
# manually flip this back to n in a local `idf.py menuconfig` run
# before flashing.
#
# DIV_NUM/DIV_DEN here is a single project-wide multiplier. With ideal
# 1:1 resistors the math is 2/1; in practice tolerance + ADC bias
# pushes the reading ~3% low, so 33/16 (= 2.0625) lands the live
# bench-validated board within ±15 mV of bench across 3500–4200 mV.
# A future PR moves these into narbis_runtime_config_t (NVS-persisted,
# dashboard-tweakable, OTA-survivable) so each board can keep its own
# trim — until then the project default is the bench-calibrated 33/16.
CONFIG_NARBIS_BATT_DIVIDER_PRESENT=y
CONFIG_NARBIS_BATT_ADC_GPIO=1
CONFIG_NARBIS_BATT_ADC_DIV_NUM=33
CONFIG_NARBIS_BATT_ADC_DIV_DEN=16

# ---------------- Idle deep-sleep timeout ----------------
# Earclip enters full deep sleep after this many seconds of advertising
# with zero BLE peers connected. Wake source is the GPIO2 / D2 button
# (same as the manual hold-to-sleep gesture). Pinned here so a fresh
# sdkconfig regen can't silently change the policy. Implementation is
# the polling loop in sleep_button.c (50 ms cadence, resets the idle
# counter whenever transport_ble_any_connected() is true). Set to 0
# to disable the idle-sleep timer (manual button hold still works).
CONFIG_NARBIS_IDLE_SLEEP_TIMEOUT_S=300
```

## firmware/test/espnow_receiver_fixture/sdkconfig.defaults
```kconfig
# Receiver fixture — minimal config. No BLE, no SoftAP.
CONFIG_BT_ENABLED=n
CONFIG_ESP_WIFI_SOFTAP_SUPPORT=n
CONFIG_ESP_WIFI_NVS_ENABLED=n
CONFIG_LOG_DEFAULT_LEVEL_INFO=y
```
